## package/gt-be98-br-openssh/Config.in
```kconfig
config BR2_PACKAGE_GT_BE98_BR_OPENSSH
	bool "gt-be98-br-openssh"
	select BR2_PACKAGE_ZLIB
	help
	  OpenSSH 10.2p1 built from the hash-verified upstream tarball
	  for the /usr/br island, providing sftp-server (+ the scp/sftp/
	  ssh/ssh-keygen tools). openssl 3.6.2 (our gt-be98-br-openssl
	  /usr/br build) is linked STATICALLY (the device ships only
	  openssl 1.1 - a dynamic link would be an ABI mismatch); glibc
	  and zlib are dynamic against the device's own libs. Harvested
	  into the ASUS rootfs at /usr/br/libexec/sftp-server and
	  /usr/br/bin/{scp,sftp,ssh,ssh-keygen} by
	  board/gt-be98/rootfs-transform.sh. The S28 br-dropbear server
	  advertises the sftp subsystem pointing at this sftp-server, so
	  modern scp/sftp work against port 2223.
```

## package/gt-be98-br-openssl/Config.in
```kconfig
config BR2_PACKAGE_GT_BE98_BR_OPENSSL
	bool "gt-be98-br-openssl"
	help
	  Static openssl 3.6.2 CLI (OPENSSLDIR=/usr/br/etc/ssl) for the
	  /usr/br island. Built from the hash-verified upstream tarball;
	  only the apps/openssl binary is harvested into the ASUS rootfs
	  at /usr/br/bin/openssl by board/gt-be98/rootfs-transform.sh.
	  The openssl.cnf + ssl dirs ship via the git overlay.
```

## package/gt-be98-dhd-firmware/Config.in
```kconfig
config BR2_PACKAGE_GT_BE98_DHD_FIRMWARE
	bool "gt-be98-dhd-firmware"
	help
	  Broadcom dhd wireless firmware blobs (rtecdc.bin) for the
	  GT-BE98 radios 6717a0 + 6726b0. Installed to /rom/etc/wlan/dhd
	  (matching the merlin rootfs layout).

	  Proprietary, non-redistributable. Fetched from a gt-be98-packages
	  GitHub Release asset.
```

## package/gt-be98-hostapd/Config.in
```kconfig
config BR2_PACKAGE_GT_BE98_HOSTAPD
	bool "gt-be98-hostapd (hostapd_cli, vendor-source)"
	help
	  Builds hostapd_cli FROM the vendor GPL hostapd source (upstream
	  hostapd v2.10 + Broadcom patches, impl103). hostapd_cli is the
	  self-contained wpa_ctrl client (no driver / openssl / libnl / BRCM
	  glue) and is the clean-from-source proof for the hostapd tree.

	  The full hostapd DAEMON is NOT built here: its vendor brcm.config
	  (DRIVER_BRCM + MLO/MAP) is gated behind the Broadcom SDK header
	  graph (HND_SRC/SRCBASE) and links libceshared/libnl-3/openssl-1.1/
	  libnvram/libshared - i.e. the merlin SDK build environment. See the
	  package .mk and the RE wifi dossier for the daemon blocker detail.

	  Requires the firmware tree at
	  $(BR2_EXTERNAL)/../gt-be98-firmware (same dependency as the
	  production rootfs/bootfs recipes). Not wired into the production
	  image.

if BR2_PACKAGE_GT_BE98_HOSTAPD

config BR2_PACKAGE_GT_BE98_HOSTAPD_DAEMON
	bool "build the full hostapd daemon (DRIVER_BRCM, from source)"
	select BR2_PACKAGE_GT_BE98_LIBSHARED
	select BR2_PACKAGE_GT_BE98_NVRAM
	help
	  Also build the full hostapd DAEMON from source via the merlin
	  SDK build-glue (the vendor router target with brcm.config:
	  DRIVER_BRCM + NL80211 + MLO/MAP/SAE/OWE/HS20/WPS, TLS=openssl,
	  CEVENT). Links the from-source libshared + libnvram, the SDK
	  from-source openssl-1.1 + libnl, and the pinned closed
	  libceshared.so (KEEP-AS-GRAFT).

	  The resulting binary, stripped, is BYTE-IDENTICAL to the shipped
	  device hostapd (sha256 7453000858a8..., DT_NEEDED identical) -- a
	  reproducible-build match. Installs hostapd + its openssl-1.1 /
	  libnl / libceshared runtime deps into the rootfs.

config BR2_PACKAGE_GT_BE98_HOSTAPD_DAEMON_OPENSSL3
	bool "static-link openssl-3.6.2 into hostapd (close the EOL-1.1 gap)"
	depends on BR2_PACKAGE_GT_BE98_HOSTAPD_DAEMON
	select BR2_PACKAGE_GT_BE98_BR_OPENSSL
	help
	  Recompile + STATIC-link the hostapd daemon against openssl-3.6.2
	  (the gt-be98-br-openssl staging tree, libcrypto.a) instead of the
	  SDK's bundled, end-of-life openssl-1.1.1w. hostapd is the device's
	  SOLE live openssl-1.1 consumer, so this closes the EOL-1.1 gap.

	  No source edits: crypto_openssl.c already carries the openssl-3
	  #if-branches; the SAME source recompiles against the openssl-3
	  headers. The unused -lssl is dropped (hostapd imports 0 libssl
	  symbols; CONFIG_EAP is off). The result NEEDs NO libcrypto.so.1.1
	  / libssl.so.1.1 -- openssl-3 is baked in statically, so those
	  shared libs are NOT installed alongside hostapd in this mode.

	  WiFi-7 (MLO/320MHz, driver_nl80211.c) + SAE/WPA3 (sae.c) carry zero
	  openssl refs; all crypto is isolated in crypto_openssl.c. Operator
	  must runtime-trial: SAE/WPA3 + WiFi-7 association.

endif
```

## package/gt-be98-libshared/Config.in
```kconfig
config BR2_PACKAGE_GT_BE98_LIBSHARED
	bool "gt-be98-libshared (libshared.so, from source)"
	help
	  Builds the asuswrt router/shared library (libshared.so) FROM
	  SOURCE via the merlin SDK build-glue (SRCBASE/HND_SRC + the
	  fully-expanded -DGTBE98 CFLAGS). 58 open .c compiled here; the
	  15 closed + 4 SDK-buildable prebuild/*.o linked as pinned graft
	  inputs. ABI-perfect vs the device libshared.so (1449/1449
	  exported symbols, 197/197 undefined, identical DT_NEEDED).

	  This is the from-source core that lets rc / hostapd link
	  -lshared without the prebuilt blob. Requires the firmware tree
	  at $(BR2_EXTERNAL)/../gt-be98-firmware. Not wired into the
	  production image.
```

## package/gt-be98-nvram/Config.in
```kconfig
config BR2_PACKAGE_GT_BE98_NVRAM
	bool "gt-be98-nvram (PARKED/experimental - decision B pins the blob)"
	help
	  PARKED (DECISION B): the from-source rootfs pins the STOCK nvram
	  blob (graft-manifest.txt); this clean-room recipe is retained as
	  experimental (builds + stages -lnvram for link) but is NOT the
	  supported on-device path - it caused an incomplete boot in trials.

	  Open libnvram.so + nvram CLI for the GT-BE98. A clean-room
	  userspace client for the NETLINK_WLCSM (proto 31) protocol of
	  the OPEN in-kernel store bcm_knvram.ko, replacing the closed,
	  prebuilt vendor libnvram.so / nvram. Built entirely from the
	  open GPL kernel protocol (wlcsm_linux.h + wlcsm_netlink.c +
	  wlcsm_nvram.c); zero closed surface.

	  NOTE: protocol-verified against the open kernel source but NOT
	  yet bench-validated against a live bcm_knvram.ko. Not wired into
	  the production image. MAC-class vars (et0macaddr, *_hwaddr,
	  label_mac) must never be set/committed (owned by envrams).
```

## package/gt-be98-rc/Config.in
```kconfig
config BR2_PACKAGE_GT_BE98_RC
	bool "gt-be98-rc (rc, from source)"
	select BR2_PACKAGE_GT_BE98_LIBSHARED
	select BR2_PACKAGE_GT_BE98_NVRAM
	help
	  Builds the asuswrt-merlin router init/service engine (rc) FROM
	  SOURCE via the merlin SDK build-glue (SRCBASE/HND_SRC + the
	  fully-expanded -DGTBE98 CFLAGS) with
	  ASUSWRT_BRCM_SDK_VERSION=WIFI7_SDK_20231126 (selects the GT-BE98
	  _be prebuild .o variant). The 108 open .c are compiled and linked
	  against: the from-source libshared (gt-be98-libshared), the
	  from-source/clean-room libnvram (gt-be98-nvram), and the
	  irreducible-core vendor libs (wpa_client/ethctl/gen_util/sys_util/
	  wlcsm/bcm_flashutil/bcm_util/bcm_boardctl/bcm/wlc_nt_client/disk +
	  json-c/sqlite/openssl) which are PINNED graft inputs sourced from
	  the SDK build tree.

	  Result: ELF32 ARM EABI5 executable, full DT_NEEDED closure (36
	  libs) resolves; rc verbs (start_*/stop_*/notify_rc/sync_boot_state)
	  present. This is the from-source rc that unblocks the OpenRC
	  rc-demotion (reboot-site patches). Requires the firmware tree at
	  $(BR2_EXTERNAL)/../gt-be98-firmware. Not wired into the production
	  image.
```

## package/gt-be98-rootfs/Config.in
```kconfig
config BR2_PACKAGE_GT_BE98_ROOTFS
	bool "gt-be98-rootfs (complete ASUS rootfs.img)"
	help
	  Merlin's FINAL ASUS GT-BE98 root filesystem image (rootfs.img: an
	  all-root xz squashfs) — content-identical to a working merlin flash.
	  It is the full proprietary userspace (rc/cfg_server engine, wl/dhd,
	  hostapd, /www) AFTER merlin's buildFS post-processing.

	  post-image-full.sh uses it verbatim as rootfs.squashfs, so the .pkgtb
	  matches the stock firmware. Network + SSH come back from the persistent
	  nvram + /jffs after a flash. The proprietary WiFi engine can't be
	  rebuilt from source, and raw fs.install isn't equivalent (it's the
	  pre-processed tree), so this reuses the built image wholesale.

	  Use this for the "working firmware" build (gt-be98_full_defconfig);
	  supersedes the granular gt-be98-userspace-base/-samba packages.
	  Proprietary; fetched from a gt-be98-packages Release asset.
```

## package/gt-be98-samba/Config.in
```kconfig
config BR2_PACKAGE_GT_BE98_SAMBA
	bool "gt-be98-samba"
	help
	  ASUS Samba server for the GT-BE98: the self-contained samba_multicall
	  binary with smbd/nmbd/smbpasswd symlinks, plus write_smb_conf.
	  Installed to /usr/sbin and /sbin (merlin layout).

	  Used instead of upstream samba4, which can't be built with the
	  gcc-10.3 external toolchain (its cmocka dep needs GCC 11+).
	  Proprietary; fetched from a gt-be98-packages Release asset.
```

## package/gt-be98-userspace-base/Config.in
```kconfig
config BR2_PACKAGE_GT_BE98_USERSPACE_BASE
	bool "gt-be98-userspace-base"
	help
	  Core asuswrt userspace for the GT-BE98: the nvram, rc, wl, dhd and
	  httpd binaries plus their proprietary ASUS shared-library closure
	  (libnvram, libshared, libwlcsm, libbcm_*, etc.). Installed into
	  /bin, /sbin, /usr/sbin, /lib, /usr/lib (merlin rootfs layout).

	  These are glibc-2.32 binaries (same toolchain as the target), so
	  they run on the Buildroot rootfs. Proprietary, non-redistributable;
	  fetched from a gt-be98-packages Release asset.

	  NOTE: this provides the binaries/libraries (component presence).
	  Full functional bring-up (init/rc wiring, nvram defaults, web UI
	  assets under /www) is layered separately.
```
