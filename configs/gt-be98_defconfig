## configs/gt-be98_defconfig
```kconfig
# GT-BE98 Buildroot defconfig — Step 1: external toolchain + minimal rootfs.
#
# Arch/ABI below are CONFIRMED from the merlin cross-compiler (gcc -v on
# crosstools-arm_softfp-gcc-10.3): 32-bit ARM, cortex-a9, EABI soft-float ABI,
# VFPv3. Built against the latest stable Buildroot (2026.02.2); the external
# toolchain (gcc 10.3) is consumed as-is. NB gcc 10.3 lacks some GCC-11+ features,
# so a few modern upstream packages won't build (e.g. samba4 -> cmocka 2.0.2 uses
# __attribute__((access(none)))) — prefer ASUS blobs for those. Kernel/bootloader
# from source remain deferred (see ARCHITECTURE.md / AGENTS.md).
#
# Build with:
#   make BR2_EXTERNAL=/path/to/gt-be98-buildroot gt-be98_defconfig
#   make

# --- Target architecture (CONFIRMED) -----------------------------------------
BR2_arm=y
BR2_cortex_a9=y
BR2_ARM_EABI=y
# cortex-a9 has VFP only optionally (MAYBE_HAS_VFPV3), so VFP must be explicitly
# enabled before the VFPv3 FPU choice is selectable — otherwise Buildroot
# silently falls back to soft float, which is ABI-incompatible with the softfp
# sysroot. Toolchain is -mfloat-abi=softfp -mfpu=vfpv3.
BR2_ARM_ENABLE_VFP=y
BR2_ARM_FPU_VFPV3=y
# merlin compiles userspace+kernel with: -mcpu=cortex-a9 -marm
#   -march=armv7-a+mp+sec+vfpv3 -mfloat-abi=softfp -mfpu=vfpv3 -mabi=aapcs-linux
# (Userspace/rootfs is 32-bit ARM. NB the kernel itself is aarch64 — built
# separately with the aarch64 crosstool; that's Step 2b, not this target.)

# --- External toolchain (gt-be98-toolchain) ----------------------------------
# Versions confirmed from the compiler: gcc 10.3.0, binutils 2.36.1,
# glibc 2.32, kernel-headers 4.19. Tuple arm-buildroot-linux-gnueabi.
BR2_TOOLCHAIN_EXTERNAL=y
BR2_TOOLCHAIN_EXTERNAL_CUSTOM=y
#
# Toolchain SOURCE: download the single-variant tarball from its gt-be98-toolchain
# Release asset (built by scripts/make-buildroot-toolchain-tarball.sh). Verified
# end-to-end. For offline/local dev you can instead set BR2_TOOLCHAIN_EXTERNAL_PATH
# to a pre-extracted crosstools dir.
BR2_TOOLCHAIN_EXTERNAL_DOWNLOAD=y
BR2_TOOLCHAIN_EXTERNAL_URL="https://github.com/nebuloss/gt-be98-toolchain/releases/download/arm_softfp-gcc10.3/gt-be98-toolchain-arm_softfp-gcc10.3.tar.gz"
BR2_TOOLCHAIN_EXTERNAL_CUSTOM_PREFIX="arm-buildroot-linux-gnueabi"
BR2_TOOLCHAIN_EXTERNAL_GCC_10=y
BR2_TOOLCHAIN_EXTERNAL_HEADERS_4_19=y
BR2_TOOLCHAIN_EXTERNAL_CUSTOM_GLIBC=y
BR2_TOOLCHAIN_EXTERNAL_CXX=y
# This glibc 2.32 was built without the deprecated Sun RPC (removed from modern
# glibc); RPC support defaults on for glibc, so disable it or the toolchain check
# fails ("RPC support not available in C library").
# BR2_TOOLCHAIN_EXTERNAL_INET_RPC is not set

# --- Kernel (TODO — roadmap step 2) ------------------------------------------
# Broadcom 4.19 vendor kernel + BCM6813 dts/defconfig. Major task.

# --- Bootloader + image (roadmap step 2) -------------------------------------
# Step 2a: board/gt-be98/post-image.sh wraps the rootfs with a prebuilt bootfs
# .itb into a .pkgtb. mkimage comes from Buildroot's host-uboot-tools (the bundle
# is a plain FIT, so no Broadcom-specific mkimage is needed) — this removes the
# merlin-tree mkimage dependency; only the prebuilt bootfs .itb is still borrowed
# (-> gt-be98-packages blob). Step 2b will build the kernel/ATF/U-Boot from source.
BR2_PACKAGE_HOST_UBOOT_TOOLS=y
# FIT support is required: the bundle FIT carries sha256 hash nodes, which a
# non-FIT mkimage rejects (prints usage, exits 1).
BR2_PACKAGE_HOST_UBOOT_TOOLS_FIT_SUPPORT=y

# --- Root filesystem ---------------------------------------------------------
BR2_TARGET_ROOTFS_SQUASHFS=y
# merlin's rootfs.img is squashfs v4.0, xz, 128K block (the squashfs default),
# all-root (confirmed via `file`/mksquashfs args). Match the compressor:
BR2_TARGET_ROOTFS_SQUASHFS4_XZ=y

# --- Init / base userspace ---------------------------------------------------
BR2_INIT_BUSYBOX=y

# --- Userspace components (Step 4) -------------------------------------------
# Generic components that the merlin artifact ships and Buildroot has upstream
# (verify-artifact.sh checklist). The ASUS-specific ones (nvram, wl/dhd, httpd +
# web UI, rc/init, rtecdc.bin) become gt-be98-packages recipes/blobs separately.
BR2_PACKAGE_OPENSSL=y
BR2_PACKAGE_CJSON=y
BR2_PACKAGE_LIGHTTPD=y
BR2_PACKAGE_OPENVPN=y
BR2_PACKAGE_DROPBEAR=y
BR2_PACKAGE_STRONGSWAN=y
BR2_PACKAGE_STRONGSWAN_STROKE=y

# --- GT-BE98-specific components (Steps 3-4, gt-be98-packages blobs) ----------
# dhd wireless firmware (rtecdc.bin for radios 6717a0 + 6726b0).
BR2_PACKAGE_GT_BE98_DHD_FIRMWARE=y
# core asus userspace (nvram, rc, wl, dhd, httpd) + ASUS shared-lib closure.
BR2_PACKAGE_GT_BE98_USERSPACE_BASE=y
# The two below are built + verified but their Release assets aren't uploaded yet,
# so they're left OFF to keep a fresh-clone build self-contained/green. Uncomment
# once the gt-be98-packages samba-1.0 / bootfs-1.0 Release assets are published:
#   ASUS samba (smbd/nmbd) — upstream samba4 won't build on gcc 10.3.
# BR2_PACKAGE_GT_BE98_SAMBA=y
#   prebuilt bootfs .itb -> BINARIES_DIR (post-image bundles it; no merlin tree).
# BR2_PACKAGE_GT_BE98_BOOTFS=y

# --- Board hooks -------------------------------------------------------------
BR2_ROOTFS_OVERLAY="$(BR2_EXTERNAL_GT_BE98_PATH)/board/gt-be98/rootfs_overlay"
BR2_ROOTFS_POST_BUILD_SCRIPT="$(BR2_EXTERNAL_GT_BE98_PATH)/board/gt-be98/post-build.sh"
BR2_ROOTFS_POST_IMAGE_SCRIPT="$(BR2_EXTERNAL_GT_BE98_PATH)/board/gt-be98/post-image.sh"
```

## configs/gt-be98_fromsrc_defconfig
```kconfig
# From-source userspace defconfig for the GT-BE98 open-OS migration.
#
# Lives BESIDE gt-be98_full_defconfig (the production baseline) and never
# replaces it. Selects the from-source recipes (libshared / nvram / hostapd)
# built via the merlin SDK build-glue, IN PLACE OF the blob-grafted versions,
# to measure the from-source vs pinned-Broadcom-graft split of the userspace.
#
# Toolchain identical to gt-be98_full_defconfig (cached external gcc-10.3).
#
# Build (isolated output, never clobbers the shared full build):
#   make BR2_EXTERNAL=/home/guillaume/be98/gt-be98-buildroot \
#        O=/home/guillaume/be98/buildroot/output-fromsrc gt-be98_fromsrc_defconfig
#   make O=/home/guillaume/be98/buildroot/output-fromsrc

BR2_arm=y
BR2_cortex_a9=y
BR2_ARM_EABI=y
BR2_ARM_ENABLE_VFP=y
BR2_ARM_FPU_VFPV3=y

BR2_TOOLCHAIN_EXTERNAL=y
BR2_TOOLCHAIN_EXTERNAL_CUSTOM=y
BR2_TOOLCHAIN_EXTERNAL_DOWNLOAD=y
BR2_TOOLCHAIN_EXTERNAL_URL="https://github.com/nebuloss/gt-be98-toolchain/releases/download/arm_softfp-gcc10.3/gt-be98-toolchain-arm_softfp-gcc10.3.tar.gz"
BR2_TOOLCHAIN_EXTERNAL_CUSTOM_PREFIX="arm-buildroot-linux-gnueabi"
BR2_TOOLCHAIN_EXTERNAL_GCC_10=y
BR2_TOOLCHAIN_EXTERNAL_HEADERS_4_19=y
BR2_TOOLCHAIN_EXTERNAL_CUSTOM_GLIBC=y
BR2_TOOLCHAIN_EXTERNAL_CXX=y
# BR2_TOOLCHAIN_EXTERNAL_INET_RPC is not set

BR2_INIT_NONE=y
# BR2_PACKAGE_BUSYBOX is not set
BR2_SYSTEM_BIN_SH_NONE=y
# BR2_TARGET_GENERIC_GETTY is not set
BR2_ROOTFS_DEVICE_TABLE=""

# From-source userspace recipes (the open half of the rootfs)
BR2_PACKAGE_GT_BE98_LIBSHARED=y
BR2_PACKAGE_GT_BE98_NVRAM=y
BR2_PACKAGE_GT_BE98_HOSTAPD=y
```

## configs/gt-be98_full_defconfig
```kconfig
# GT-BE98 "full firmware" defconfig — Buildroot assembles a WORKING image whose
# rootfs is the complete ASUS userspace (content-identical to the stock/merlin
# firmware). Network + WiFi + SSH are driven by the proprietary ASUS engine
# (rc/cfg_server/wl/hostapd), which can't be rebuilt from source — so it's reused
# wholesale. Customize via /jffs + nvram (both persist across flashes).
#
#   make BR2_EXTERNAL=/path/to/gt-be98-buildroot gt-be98_full_defconfig && make
#   -> output/images/GT-BE98_nand_squashfs.pkgtb  (flashable like a merlin build)

# --- Target architecture (confirmed) -----------------------------------------
BR2_arm=y
BR2_cortex_a9=y
BR2_ARM_EABI=y
BR2_ARM_ENABLE_VFP=y
BR2_ARM_FPU_VFPV3=y

# --- External toolchain (download from Release) ------------------------------
BR2_TOOLCHAIN_EXTERNAL=y
BR2_TOOLCHAIN_EXTERNAL_CUSTOM=y
BR2_TOOLCHAIN_EXTERNAL_DOWNLOAD=y
BR2_TOOLCHAIN_EXTERNAL_URL="https://github.com/nebuloss/gt-be98-toolchain/releases/download/arm_softfp-gcc10.3/gt-be98-toolchain-arm_softfp-gcc10.3.tar.gz"
BR2_TOOLCHAIN_EXTERNAL_CUSTOM_PREFIX="arm-buildroot-linux-gnueabi"
BR2_TOOLCHAIN_EXTERNAL_GCC_10=y
BR2_TOOLCHAIN_EXTERNAL_HEADERS_4_19=y
BR2_TOOLCHAIN_EXTERNAL_CUSTOM_GLIBC=y
BR2_TOOLCHAIN_EXTERNAL_CXX=y
# BR2_TOOLCHAIN_EXTERNAL_INET_RPC is not set

# --- No Buildroot userspace: the rootfs IS the ASUS fs.install ---------------
# ASUS rc is PID1 (/sbin/init -> rc); Buildroot supplies no init and no busybox,
# the gt-be98-rootfs package + post-build-full.sh make the rootfs == fs.install.
BR2_INIT_NONE=y
# BR2_PACKAGE_BUSYBOX is not set
BR2_SYSTEM_BIN_SH_NONE=y
# BR2_TARGET_GENERIC_GETTY is not set

# --- Root filesystem ---------------------------------------------------------
BR2_TARGET_ROOTFS_SQUASHFS=y
BR2_TARGET_ROOTFS_SQUASHFS4_XZ=y
# Empty device table: the ASUS rootfs uses devtmpfs (empty /dev, like merlin) and
# has /root,/etc,/var as symlinks to tmpfs, so the default device_table.txt
# (which chowns /root and expects /etc/passwd,/etc/shadow) makes `makedevs` fail.
# Buildroot still chowns the whole tree to 0:0 (root), matching merlin's -all-root.
BR2_ROOTFS_DEVICE_TABLE=""

# --- Image tooling -----------------------------------------------------------
BR2_PACKAGE_HOST_UBOOT_TOOLS=y
BR2_PACKAGE_HOST_UBOOT_TOOLS_FIT_SUPPORT=y

# --- GT-BE98 firmware content ------------------------------------------------
# Complete ASUS userspace rootfs + the prebuilt bootfs .itb (kernel/ATF/U-Boot).
BR2_PACKAGE_GT_BE98_ROOTFS=y
BR2_PACKAGE_GT_BE98_BOOTFS=y

# --- Board hooks -------------------------------------------------------------
# Buildroot builds a throwaway minimal rootfs; post-image-full.sh then rebuilds
# rootfs.squashfs directly from the ASUS fs.install (merlin's exact mksquashfs),
# and post-image.sh bundles the .pkgtb from it + the package-provided bootfs .itb.
# (No post-build mutation of the target — avoids fighting target-finalize over the
# ASUS /etc,/var,/root tmpfs symlinks.)
BR2_ROOTFS_POST_IMAGE_SCRIPT="$(BR2_EXTERNAL_GT_BE98_PATH)/board/gt-be98/post-image-full.sh $(BR2_EXTERNAL_GT_BE98_PATH)/board/gt-be98/post-image.sh"
```

## configs/gt-be98_openrc-init_defconfig
```kconfig
# GT-BE98 phase3 OpenRC open-init defconfig (BUILD-ONLY, ISOLATED).
#
# Copy of gt-be98_full_defconfig with the ASUS rc PID1 replaced by OpenRC
# (openrc-init). This config exists solely to CROSS-BUILD the OpenRC package
# (openrc-init/librc/libeinfo + stock service scripts) for the phase3 open-init
# rootfs assembly (board/gt-be98/phase3/openrc/openrc-assemble.sh). It is NOT a
# production firmware config and must never replace gt-be98_full_defconfig.
#
# Build only the openrc package (do NOT run a full `make`):
#   make BR2_EXTERNAL=/path/to/gt-be98-buildroot O=output-openrc-init \
#        gt-be98_openrc-init_defconfig
#   make BR2_EXTERNAL=/path/to/gt-be98-buildroot O=output-openrc-init openrc
#
# The OpenRC package is patched (package/openrc/openrc.mk) to build with
# --sysconfdir=/rom/etc (blocker A: merlin /etc is a tmpfs, persistent config
# lives in read-only /rom/etc), so openrc-init looks for /rom/etc/runlevels.

# --- Target architecture (confirmed) -----------------------------------------
BR2_arm=y
BR2_cortex_a9=y
BR2_ARM_EABI=y
BR2_ARM_ENABLE_VFP=y
BR2_ARM_FPU_VFPV3=y

# --- External toolchain (download from Release) ------------------------------
BR2_TOOLCHAIN_EXTERNAL=y
BR2_TOOLCHAIN_EXTERNAL_CUSTOM=y
BR2_TOOLCHAIN_EXTERNAL_DOWNLOAD=y
BR2_TOOLCHAIN_EXTERNAL_URL="https://github.com/nebuloss/gt-be98-toolchain/releases/download/arm_softfp-gcc10.3/gt-be98-toolchain-arm_softfp-gcc10.3.tar.gz"
BR2_TOOLCHAIN_EXTERNAL_CUSTOM_PREFIX="arm-buildroot-linux-gnueabi"
BR2_TOOLCHAIN_EXTERNAL_GCC_10=y
BR2_TOOLCHAIN_EXTERNAL_HEADERS_4_19=y
BR2_TOOLCHAIN_EXTERNAL_CUSTOM_GLIBC=y
BR2_TOOLCHAIN_EXTERNAL_CXX=y
# BR2_TOOLCHAIN_EXTERNAL_INET_RPC is not set

# --- Init: OpenRC (the open-init milestone) ----------------------------------
# Replaces BR2_INIT_NONE from the production config. BR2_PACKAGE_OPENRC depends
# on BR2_INIT_OPENRC, which pulls openrc + libcap + ncurses + kmod (+ libxcrypt
# on glibc). We only `make openrc` to stage binaries; we do NOT assemble a
# Buildroot rootfs (the open-init rootfs is assembled from the br-0050 baseline
# by openrc-assemble.sh).
BR2_INIT_OPENRC=y
BR2_PACKAGE_OPENRC=y

# --- Root filesystem ---------------------------------------------------------
BR2_TARGET_ROOTFS_SQUASHFS=y
BR2_TARGET_ROOTFS_SQUASHFS4_XZ=y
BR2_ROOTFS_DEVICE_TABLE=""

# --- Image tooling -----------------------------------------------------------
BR2_PACKAGE_HOST_UBOOT_TOOLS=y
BR2_PACKAGE_HOST_UBOOT_TOOLS_FIT_SUPPORT=y
```

## configs/gt-be98_pkgtest_defconfig
```kconfig
# Isolated package-test defconfig for the from-source userspace track.
# Toolchain identical to gt-be98_full_defconfig (cached external gcc-10.3).
# Selects ONLY the new from-source recipes so they can be built via Buildroot
# (`make gt-be98-<pkg>`) without touching the production baseline image.
# NOT a flashable config: no rootfs/bootfs blob, no post-image script.

BR2_arm=y
BR2_cortex_a9=y
BR2_ARM_EABI=y
BR2_ARM_ENABLE_VFP=y
BR2_ARM_FPU_VFPV3=y

BR2_TOOLCHAIN_EXTERNAL=y
BR2_TOOLCHAIN_EXTERNAL_CUSTOM=y
BR2_TOOLCHAIN_EXTERNAL_DOWNLOAD=y
BR2_TOOLCHAIN_EXTERNAL_URL="https://github.com/nebuloss/gt-be98-toolchain/releases/download/arm_softfp-gcc10.3/gt-be98-toolchain-arm_softfp-gcc10.3.tar.gz"
BR2_TOOLCHAIN_EXTERNAL_CUSTOM_PREFIX="arm-buildroot-linux-gnueabi"
BR2_TOOLCHAIN_EXTERNAL_GCC_10=y
BR2_TOOLCHAIN_EXTERNAL_HEADERS_4_19=y
BR2_TOOLCHAIN_EXTERNAL_CUSTOM_GLIBC=y
BR2_TOOLCHAIN_EXTERNAL_CXX=y
# BR2_TOOLCHAIN_EXTERNAL_INET_RPC is not set

BR2_INIT_NONE=y
# BR2_PACKAGE_BUSYBOX is not set
BR2_SYSTEM_BIN_SH_NONE=y
# BR2_TARGET_GENERIC_GETTY is not set
BR2_ROOTFS_DEVICE_TABLE=""

# From-source userspace recipes under test
BR2_PACKAGE_GT_BE98_NVRAM=y
```

## package/gt-be98-bootfs/Config.in
```kconfig
config BR2_PACKAGE_GT_BE98_BOOTFS
	bool "gt-be98-bootfs"
	help
	  Prebuilt GT-BE98 bootfs FIT image (bcm96813GW_uboot_linux.itb):
	  ATF + U-Boot + aarch64 kernel (lzo) + per-board DTBs + OP-TEE.

	  Installs the .itb into $(BINARIES_DIR) so board/gt-be98/post-image.sh
	  wraps the Buildroot rootfs.squashfs around it into the flashable
	  .pkgtb — without needing the merlin source tree present. This is the
	  Step 2a "reuse the prebuilt boot chain" path (kernel-from-source is
	  the deferred Step 2b).

	  Proprietary; fetched from a gt-be98-packages Release asset.
```

## package/gt-be98-br-busybox/Config.in
```kconfig
config BR2_PACKAGE_GT_BE98_BR_BUSYBOX
	bool "gt-be98-br-busybox"
	help
	  Static busybox 1.37.0 for the /usr/br island. Built from the
	  hash-verified upstream tarball with the pinned config in this
	  package directory; harvested into the ASUS rootfs at
	  /usr/br/bin by board/gt-be98/rootfs-transform.sh (binary +
	  applet symlinks). Never installed to Buildroot's throwaway
	  target rootfs.
```

## package/gt-be98-br-dropbear/Config.in
```kconfig
config BR2_PACKAGE_GT_BE98_BR_DROPBEAR
	bool "gt-be98-br-dropbear"
	help
	  Static dropbearmulti 2025.89 (dropbear/dbclient/ssh/
	  dropbearkey/ssh-keygen/scp, key-auth only) for the /usr/br
	  island, used by the S28 br-dropbear rail on port 2223. Built
	  from the hash-verified upstream tarball; harvested into the
	  ASUS rootfs at /usr/br/sbin/dropbearmulti by
	  board/gt-be98/rootfs-transform.sh.
```
