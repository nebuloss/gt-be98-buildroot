## package/gt-be98-vendor-firmware/Config.in
```kconfig
config BR2_PACKAGE_GT_BE98_VENDOR_FIRMWARE
	bool "gt-be98-vendor-firmware (proprietary blobs from local dirs)"
	select BR2_PACKAGE_GT_BE98_OS
	help
	  Copies the proprietary firmware the open drivers load from the
	  stock firmware, from local directories on the build host named in
	  the local configuration file (BR2_PACKAGE_GT_BE98_OS_LOCAL_CONF):
	    FW_RUNNER_DIR  bcm4916-runner-microcode.bin, merlin16-shortfin.bin
	    FW_PHY_DIR     stock /rom/etc/fw (xphy_firmware.bin,
	                   blackfin_b0_firmware.bin)
	    FW_WIFI_DIR    stock /rom/etc/wlan (dhd/*/release/rtecdc.bin,
	                   nvram/GT-BE98.nvm)
	  Every file is checked against the sha256 recorded in
	  gt-be98-vendor-firmware.mk. A directory left empty is skipped
	  with a warning. The blobs are never part of any repository.
```

## package/gt-be98-webui/Config.in
```kconfig
config BR2_PACKAGE_GT_BE98_WEBUI
	bool "gt-be98-webui (prebuilt webui-go, mainline-os port)"
	select BR2_PACKAGE_GT_BE98_OS
	help
	  Installs the prebuilt gt-be98-webui-go delivery (branch
	  mainline-os, built separately on the build host) from a local
	  directory:
	    webui                 -> /usr/sbin/webui
	    www/                  -> /usr/share/webui/www/
	    openrc/webui          -> /etc/init.d/webui
	    openrc/webui.confd    -> /etc/conf.d/webui
	    platform.conf.example -> /etc/webui/platform.conf (if absent)
	  The service is installed but NOT enabled (rc-update add webui
	  default). Empty directory: only /etc/webui and a placeholder
	  service are installed.

if BR2_PACKAGE_GT_BE98_WEBUI

config BR2_PACKAGE_GT_BE98_WEBUI_DIR
	string "webui delivery directory (build host)"
	default ""
	help
	  Absolute path of the webui-go build output (the directory with
	  webui, www/, openrc/, platform.conf.example). Set from WEBUI_DIR
	  in the local configuration by board/gt-be98-mainline/build.sh.

endif
```
