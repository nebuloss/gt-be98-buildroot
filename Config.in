## Config.in
```kconfig
menu "GT-BE98 packages"

source "$BR2_EXTERNAL_GT_BE98_PATH/package/gt-be98-dhd-firmware/Config.in"
source "$BR2_EXTERNAL_GT_BE98_PATH/package/gt-be98-userspace-base/Config.in"
source "$BR2_EXTERNAL_GT_BE98_PATH/package/gt-be98-samba/Config.in"
source "$BR2_EXTERNAL_GT_BE98_PATH/package/gt-be98-bootfs/Config.in"
source "$BR2_EXTERNAL_GT_BE98_PATH/package/gt-be98-rootfs/Config.in"
source "$BR2_EXTERNAL_GT_BE98_PATH/package/gt-be98-br-busybox/Config.in"
source "$BR2_EXTERNAL_GT_BE98_PATH/package/gt-be98-br-dropbear/Config.in"
source "$BR2_EXTERNAL_GT_BE98_PATH/package/gt-be98-br-openssl/Config.in"
source "$BR2_EXTERNAL_GT_BE98_PATH/package/gt-be98-br-openssh/Config.in"
source "$BR2_EXTERNAL_GT_BE98_PATH/package/gt-be98-nvram/Config.in"
source "$BR2_EXTERNAL_GT_BE98_PATH/package/gt-be98-libshared/Config.in"
source "$BR2_EXTERNAL_GT_BE98_PATH/package/gt-be98-hostapd/Config.in"
source "$BR2_EXTERNAL_GT_BE98_PATH/package/gt-be98-rc/Config.in"


comment "GT-BE98 mainline OS (aarch64, mainline kernel)"
source "$BR2_EXTERNAL_GT_BE98_PATH/package/gt-be98-os/Config.in"
source "$BR2_EXTERNAL_GT_BE98_PATH/package/gt-be98-open-ethernet/Config.in"
source "$BR2_EXTERNAL_GT_BE98_PATH/package/gt-be98-open-wifi/Config.in"
source "$BR2_EXTERNAL_GT_BE98_PATH/package/gt-be98-vendor-firmware/Config.in"
source "$BR2_EXTERNAL_GT_BE98_PATH/package/gt-be98-rescue-busybox/Config.in"
source "$BR2_EXTERNAL_GT_BE98_PATH/package/gt-be98-webui/Config.in"

endmenu
```

## configs/gt-be98_mainline_defconfig
```kconfig
# GT-BE98 (BCM4916) mainline development OS.
# Linux 7.2.9 + the open-ethernet patch series, OpenRC, glibc, upstream tools.
# Build: board/gt-be98-mainline/build.sh (sets the local configuration file).
# Design, image layout, sizes: board/gt-be98-mainline/README.md.

# --- target ---------------------------------------------------------------------
BR2_aarch64=y
BR2_cortex_a53=y

# --- toolchain: Buildroot internal, glibc, default (stable) GCC -----------------
BR2_TOOLCHAIN_BUILDROOT_GLIBC=y
BR2_TOOLCHAIN_BUILDROOT_CXX=y
BR2_KERNEL_HEADERS_AS_KERNEL=y
BR2_PACKAGE_HOST_LINUX_HEADERS_CUSTOM_7_1=y
BR2_SHARED_STATIC_LIBS=y
BR2_GLOBAL_PATCH_DIR="$(BR2_EXTERNAL_GT_BE98_PATH)/board/gt-be98-mainline/patches"
BR2_ENABLE_LOCALE_PURGE=y
BR2_ENABLE_LOCALE_WHITELIST="C en_US"
BR2_OPTIMIZE_2=y
BR2_STRIP_strip=y

# --- system ---------------------------------------------------------------------
BR2_TARGET_GENERIC_HOSTNAME="gt-be98"
BR2_TARGET_GENERIC_ISSUE="GT-BE98 mainline development OS"
BR2_INIT_OPENRC=y
BR2_ROOTFS_DEVICE_CREATION_DYNAMIC_DEVTMPFS=y
BR2_SYSTEM_BIN_SH_BASH=y
BR2_TARGET_GENERIC_GETTY_PORT="ttyAMA0"
BR2_TARGET_GENERIC_GETTY_BAUDRATE_115200=y
BR2_ROOTFS_POST_IMAGE_SCRIPT="$(BR2_EXTERNAL_GT_BE98_PATH)/board/gt-be98-mainline/post-image.sh"

# --- kernel: 7.2.9 + kernel-patches/mainline (gt-be98-open-ethernet) -----------
BR2_LINUX_KERNEL=y
BR2_LINUX_KERNEL_CUSTOM_VERSION=y
BR2_LINUX_KERNEL_CUSTOM_VERSION_VALUE="7.2.9"
BR2_LINUX_KERNEL_USE_CUSTOM_CONFIG=y
BR2_LINUX_KERNEL_CUSTOM_CONFIG_FILE="$(BR2_EXTERNAL_GT_BE98_PATH)/board/gt-be98-mainline/linux/linux.config"
BR2_LINUX_KERNEL_IMAGE=y
BR2_LINUX_KERNEL_NEEDS_HOST_OPENSSL=y

# --- GT-BE98 packages -----------------------------------------------------------
BR2_PACKAGE_GT_BE98_OS=y
BR2_PACKAGE_GT_BE98_OPEN_ETHERNET=y
BR2_PACKAGE_GT_BE98_OPEN_WIFI=y
BR2_PACKAGE_GT_BE98_VENDOR_FIRMWARE=y
BR2_PACKAGE_GT_BE98_RESCUE_BUSYBOX=y
BR2_PACKAGE_GT_BE98_WEBUI=y

# --- base userland (no BusyBox in the rootfs) -------------------------------------
# BR2_PACKAGE_BUSYBOX is not set
BR2_PACKAGE_BASH=y
BR2_PACKAGE_COREUTILS=y
BR2_PACKAGE_FINDUTILS=y
BR2_PACKAGE_GREP=y
BR2_PACKAGE_SED=y
BR2_PACKAGE_GAWK=y
BR2_PACKAGE_DIFFUTILS=y
BR2_PACKAGE_WHICH=y
BR2_PACKAGE_LESS=y
BR2_PACKAGE_NANO=y
BR2_PACKAGE_TAR=y
BR2_PACKAGE_GZIP=y
BR2_PACKAGE_XZ=y
BR2_PACKAGE_PROCPS_NG=y
BR2_PACKAGE_PSMISC=y
BR2_PACKAGE_HTOP=y
BR2_PACKAGE_LSOF=y
BR2_PACKAGE_KMOD=y
BR2_PACKAGE_KMOD_TOOLS=y
BR2_PACKAGE_UTIL_LINUX=y
BR2_PACKAGE_UTIL_LINUX_BINARIES=y
BR2_PACKAGE_UTIL_LINUX_AGETTY=y
BR2_PACKAGE_UTIL_LINUX_KILL=y
BR2_PACKAGE_UTIL_LINUX_LOGGER=y
BR2_PACKAGE_UTIL_LINUX_LOSETUP=y
BR2_PACKAGE_UTIL_LINUX_MORE=y
BR2_PACKAGE_UTIL_LINUX_MOUNT=y
BR2_PACKAGE_UTIL_LINUX_MOUNTPOINT=y
BR2_PACKAGE_UTIL_LINUX_NSENTER=y
BR2_PACKAGE_UTIL_LINUX_UNSHARE=y
BR2_PACKAGE_UTIL_LINUX_IRQTOP=y
BR2_PACKAGE_UTIL_LINUX_LSFD=y
BR2_PACKAGE_UTIL_LINUX_LSMEM=y

# --- networking -----------------------------------------------------------------
BR2_PACKAGE_IPROUTE2=y
BR2_PACKAGE_IPUTILS=y
BR2_PACKAGE_ETHTOOL=y
BR2_PACKAGE_DHCPCD=y
BR2_PACKAGE_OPENSSH=y
BR2_PACKAGE_CHRONY=y
BR2_PACKAGE_NFTABLES=y
BR2_PACKAGE_CONNTRACK_TOOLS=y
BR2_PACKAGE_TCPDUMP=y
BR2_PACKAGE_IPERF3=y
BR2_PACKAGE_SOCAT=y
BR2_PACKAGE_NETCAT_OPENBSD=y
BR2_PACKAGE_RSYNC=y
BR2_PACKAGE_LIBCURL=y
BR2_PACKAGE_LIBCURL_CURL=y
BR2_PACKAGE_CA_CERTIFICATES=y
BR2_PACKAGE_LIBOPENSSL=y
BR2_PACKAGE_DNSMASQ=y

# --- Wi-Fi userland ---------------------------------------------------------------
BR2_PACKAGE_IW=y
BR2_PACKAGE_WIRELESS_REGDB=y
BR2_PACKAGE_HOSTAPD=y
BR2_PACKAGE_HOSTAPD_DRIVER_NL80211=y
BR2_PACKAGE_HOSTAPD_WPA3=y
BR2_PACKAGE_HOSTAPD_ACS=y
BR2_PACKAGE_WPA_SUPPLICANT=y
BR2_PACKAGE_WPA_SUPPLICANT_NL80211=y
BR2_PACKAGE_WPA_SUPPLICANT_CLI=y
BR2_PACKAGE_WPA_SUPPLICANT_WPA3=y

# --- logging ----------------------------------------------------------------------
BR2_PACKAGE_SYSKLOGD=y

# --- debugging / driver development -------------------------------------------------
BR2_PACKAGE_STRACE=y
BR2_PACKAGE_GDB=y
BR2_PACKAGE_GDB_SERVER=y
BR2_PACKAGE_LINUX_TOOLS_PERF=y
BR2_PACKAGE_ELFUTILS=y
BR2_PACKAGE_TRACE_CMD=y
BR2_PACKAGE_MEMTOOL=y
BR2_PACKAGE_PCIUTILS=y

# --- root filesystem: squashfs (xz), packed into the kernel's initramfs ------------
BR2_TARGET_ROOTFS_SQUASHFS=y
BR2_TARGET_ROOTFS_SQUASHFS4_XZ=y
BR2_TARGET_ROOTFS_SQUASHFS_BS_1024K=y
BR2_TARGET_ROOTFS_SQUASHFS_EXTREME_COMP=y
# BR2_TARGET_ROOTFS_TAR is not set

# --- host tools for the FIT ---------------------------------------------------------
BR2_PACKAGE_HOST_UBOOT_TOOLS=y
BR2_PACKAGE_HOST_UBOOT_TOOLS_FIT_SUPPORT=y
BR2_PACKAGE_HOST_DTC=y
```

## package/gt-be98-bcm-datapath/Config.in
```kconfig
config BR2_PACKAGE_GT_BE98_BCM_DATAPATH
	bool "gt-be98-bcm-datapath"
	help
	  Closed Broadcom datapath bring-up for the GT-BE98 (BCM6813):

	    /lib/modules/4.19.294/   the BCM_KF datapath kernel modules
	                             (bcm_knvram, bdmf, rdpa*, pktflow, cmdlist,
	                             bcm_enet, pktrunner, bcmmcast, wfd, ... + wl/dhd)
	    /bin/bcm_boot_launcher   runs the /rom/etc/rc3.d S25-S50 early-init
	    /rom/etc/                rc3.d -> init.d/*.sh, rdpa_init.sh,
	                             make_static_devnodes.sh, fstab, modprobe.conf,
	                             sf2/vlan/soft_bridge, ... (wlan + adsl1 excluded)

	  This is the kernel-space + early-init half that a fully-generated rootfs
	  needs to load the HW datapath and come up reachable. Userspace (rc, nvram,
	  shared libs) is gt-be98-userspace-base; wifi firmware is gt-be98-dhd-firmware.

	  Proprietary, non-redistributable. Fetched from a gt-be98-packages
	  GitHub Release asset.
```

## package/gt-be98-br-webui/Config.in
```kconfig
config BR2_PACKAGE_GT_BE98_BR_WEBUI
	bool "gt-be98-br-webui"
	help
	  Static, pure-Go webui-go management backend for the /usr/br
	  island (M5 candidate 4, br-0047). Cross-compiled with
	  CGO_ENABLED=0 GOOS=linux GOARCH=arm GOARM=7 -> a fully static
	  ARM EABI binary (no PT_INTERP, no DT_NEEDED; modernc.org/sqlite
	  is pure Go, so no libc/CGO dependency). Built by an external host
	  Go toolchain from the sibling gt-be98-webui-go checkout (SITE is
	  override-able via GT_BE98_BR_WEBUI_SRCDIR). Harvested into the
	  ASUS rootfs at /usr/br/sbin/webui by
	  board/gt-be98/rootfs-transform.sh and launched by the S29
	  br-webui rail as a PARALLEL listener (does NOT take over :80;
	  the ASUS httpd stays running until patch-0033 gates it).
```

## package/gt-be98-open-ethernet/Config.in
```kconfig
config BR2_PACKAGE_GT_BE98_OPEN_ETHERNET
	bool "gt-be98-open-ethernet (mainline kernel series + Runner driver)"
	depends on BR2_LINUX_KERNEL
	help
	  The gt-be98-open-ethernet repository at a pinned commit:
	   - kernel-patches/mainline: the GT-BE98 patch series, applied to
	     the Buildroot kernel in the order of its README (series.pmb,
	     series, series.phy, ... series.pcie);
	   - driver/runner: the out-of-tree BCM4916 XRDP Runner Ethernet
	     driver, built as bcm4916-runner.ko against the same kernel;
	   - tools/mainline-boot: mkbootfs.py, the board dts and the kernel
	     config fragments, installed to $(HOST_DIR)/share/gt-be98-mainline
	     for post-image.sh.

	  The repository is private: the download uses git over SSH. For
	  driver work, point GT_BE98_OPEN_ETHERNET_OVERRIDE_SRCDIR at a
	  checkout in a local.mk (Buildroot manual, "Using Buildroot during
	  development").

if BR2_PACKAGE_GT_BE98_OPEN_ETHERNET

config BR2_PACKAGE_GT_BE98_OPEN_ETHERNET_KERNEL_PATCHES
	bool "apply the kernel patch series to the Buildroot kernel"
	default y
	help
	  Apply kernel-patches/mainline (all series files, README order)
	  to the kernel after its own patches.

config BR2_PACKAGE_GT_BE98_OPEN_ETHERNET_RUNNER
	bool "bcm4916-runner.ko"
	default y
	help
	  Build and install the Runner Ethernet driver module
	  (/lib/modules/<kver>/updates/bcm4916-runner.ko). The gt-be98-drivers
	  service loads it. Its firmware comes from gt-be98-vendor-firmware.

endif
```

## package/gt-be98-open-wifi/Config.in
```kconfig
config BR2_PACKAGE_GT_BE98_OPEN_WIFI
	bool "gt-be98-open-wifi (bca_pcie_ipc.ko)"
	depends on BR2_LINUX_KERNEL
	help
	  The open Wi-Fi driver for the four BCM67xx PCIe radios
	  (bca_pcie_ipc.ko, cfg80211), from gt-be98-open-wifi at a pinned
	  commit (git over SSH, private repository). Needs the kernel built
	  with the PCIe series and CONFIG_CFG80211=y (the default kernel
	  config of gt-be98_mainline_defconfig). The radio firmware comes
	  from gt-be98-vendor-firmware. Not loaded at boot: the gt-be98-wifi
	  service (disabled by default) loads it and starts hostapd.

if BR2_PACKAGE_GT_BE98_OPEN_WIFI

config BR2_PACKAGE_GT_BE98_OPEN_WIFI_BENCH
	bool "bench module parameters"
	default y
	help
	  Build with -DBCA_BENCH_PARAMS (the build that was tested on the
	  box, tools/mainline-boot/build.sh WIFI_BENCH=1). The bench-only
	  bca_barpeek.ko is never installed.

endif
```

## package/gt-be98-os/Config.in
```kconfig
config BR2_PACKAGE_GT_BE98_OS
	bool "gt-be98-os (mainline OS integration)"
	depends on BR2_INIT_OPENRC
	depends on BR2_LINUX_KERNEL
	select BR2_PACKAGE_HOST_UBOOT_TOOLS
	select BR2_PACKAGE_HOST_UBOOT_TOOLS_FIT_SUPPORT
	select BR2_PACKAGE_HOST_DTC
	help
	  GT-BE98 mainline development OS integration:
	   - OpenRC services: gt-be98-watchdog (health-gated petting),
	     dhcpcd (USB lifeline + rnr0), sshd (keys only), chronyd,
	     syslogd, gt-be98-persist (USB stick), gt-be98-drivers (Runner),
	     gt-be98-boot-done, gt-be98-netconsole (only with a target);
	     optional gt-be98-wifi, gt-be98-telnet,
	     dnsmasq;
	   - gt-be98-postcode / -health / -wdtd / -status, a guarded devmem;
	   - the rescue initramfs /init (installed to $(BINARIES_DIR)/rescue/),
	     used by board/gt-be98-mainline/post-image.sh;
	   - lab-specific values (SSH keys, host keys, static fallback
	     address, remote syslog) from the local configuration file.

if BR2_PACKAGE_GT_BE98_OS

config BR2_PACKAGE_GT_BE98_OS_LOCAL_CONF
	string "local configuration file (build host, not in git)"
	default ""
	help
	  Absolute path of a shell KEY=VALUE file with the lab-specific
	  settings (template: board/gt-be98-mainline/local.conf.example).
	  board/gt-be98-mainline/build.sh sets it. Empty: no SSH key (the
	  passwordless USB telnet lifeline is then enabled), no firmware,
	  and post-image.sh cannot build the FIT (it needs STOCK_BOOTFS).

config BR2_PACKAGE_GT_BE98_OS_RELEASE
	bool "release image (no lab secrets, no lab addresses)"
	help
	  Build a release image: board/gt-be98-mainline/build.sh sets it
	  with RELEASE=1 (environment or local configuration; template
	  board/gt-be98-mainline/release.conf.example). The build then
	  refuses every local-configuration value that would put a lab
	  secret or a lab address into the image (SSH_HOSTKEY_DIR,
	  WEBUI_PASSWORD[_HASH], ROOTFS_URL, SYSLOG_REMOTE, NETCONSOLE,
	  RNR0_FALLBACK, USB_FALLBACK), strips the comments of
	  SSH_AUTHORIZED_KEYS, and enables the web UI with its first-login
	  setup token instead of a baked password. SSH host keys are
	  generated on the box at first boot (gt-be98-hostkeys) and kept
	  in /jffs. Check the result with
	  board/gt-be98-mainline/release-check.sh.

config BR2_PACKAGE_GT_BE98_OS_HOSTAPD_FILS
	bool "hostapd: Fast Initial Link Setup discovery (FILS)"
	depends on BR2_PACKAGE_HOSTAPD
	help
	  Build Buildroot's hostapd with CONFIG_FILS, which Buildroot's
	  hostapd package has no option for. It lets a 6 GHz BSS send FILS
	  discovery frames (fils_discovery_max_interval=); nothing changes
	  unless a config sets a fils_* key. CONFIG_FILS_SK_PFS (FILS shared
	  key authentication with PFS) is left out.

config BR2_PACKAGE_GT_BE98_OS_HOSTAPD_MBO
	bool "hostapd: Multiband Operation (MBO)"
	depends on BR2_PACKAGE_HOSTAPD
	help
	  Build Buildroot's hostapd with CONFIG_MBO (src/ap/mbo_ap.c), which
	  Buildroot's hostapd package has no option for. The MBO element is
	  only sent by a BSS whose config sets mbo=1; with WPA2, hostapd
	  then requires PMF. WNM (BSS transition management) is not
	  enabled by this option.

config BR2_PACKAGE_GT_BE98_OS_HOSTAPD_WNM
	bool "hostapd: WNM (802.11v BSS transition management)"
	depends on BR2_PACKAGE_HOSTAPD
	help
	  Build Buildroot's hostapd with CONFIG_WNM (CONFIG_WNM_AP:
	  src/ap/wnm_ap.c and the bss_transition= / wnm_sleep_mode= keys),
	  which Buildroot's hostapd package has no option for. Needed by
	  gt-be98-wifi-gen's 802.11k/v (network kv=1, the generator's KV
	  switch): without it hostapd refuses a config with bss_transition=.
	  Off: 802.11k/v waits for the Wi-Fi driver to pass the RRM/WNM
	  action frames (open-wifi INV-T6); turn it on with KV=1.

config BR2_PACKAGE_GT_BE98_OS_HOSTAPD_AIRTIME_POLICY
	bool "hostapd: airtime policy (airtime_mode)"
	depends on BR2_PACKAGE_HOSTAPD
	help
	  Build Buildroot's hostapd with CONFIG_AIRTIME_POLICY, which
	  Buildroot's hostapd package has no option for. It adds the
	  airtime_mode, airtime_bss_weight, airtime_bss_limit and
	  airtime_sta_weight keys; hostapd then hands per-station airtime
	  weights to the driver (bca_pcie_ipc maps them onto the
	  firmware's airtime management). Nothing changes unless a config
	  sets airtime_mode (default 0).

endif
```

## package/gt-be98-rescue-busybox/Config.in
```kconfig
config BR2_PACKAGE_GT_BE98_RESCUE_BUSYBOX
	bool "gt-be98-rescue-busybox (static, rescue initramfs only)"
	depends on BR2_TOOLCHAIN_USES_GLIBC
	depends on BR2_STATIC_LIBS || BR2_SHARED_STATIC_LIBS
	help
	  A statically linked BusyBox (upstream defconfig, all applets
	  except tc) for the rescue initramfs built into the kernel Image:
	  /init, the USB-Ethernet lifeline (udhcpc), telnetd and devmem when
	  the rootfs cannot be mounted. Installed to
	  $(BINARIES_DIR)/rescue/busybox, and to
	  /usr/libexec/gt-be98/busybox in the rootfs for the optional
	  gt-be98-telnet lifeline service. The rootfs itself uses the full
	  upstream tools, not BusyBox.

comment "gt-be98-rescue-busybox needs a glibc toolchain with static libraries"
	depends on !BR2_TOOLCHAIN_USES_GLIBC || !(BR2_STATIC_LIBS || BR2_SHARED_STATIC_LIBS)
```
